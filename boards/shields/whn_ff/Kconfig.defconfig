## boards/shields/whn_ff/Kconfig.defconfig
```kconfig
if SHIELD_WHN_FF

config ZMK_KEYBOARD_NAME
    default "whn_ff"

endif # SHIELD_WHN_FF
```

## boards/shields/whn_uno/Kconfig
```kconfig
# Copyright (c) 2024 The ZMK Contributors
# SPDX-License-Identifier: MIT

menu "whn_uno"

config SHIELD_WHN_UNO
	bool "whn_uno"
	select SHIELD_WHN_UNO

endmenu
```

## boards/shields/whn_uno/Kconfig.defconfig
```kconfig
# Copyright (c) 2024 The ZMK Contributors
# SPDX-License-Identifier: MIT

if SHIELD_WHN_UNO

config ZMK_KEYBOARD_NAME
	default "whn_uno"

endif
```
